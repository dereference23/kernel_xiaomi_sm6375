/delete-node/ &touch_avdd;

&qupv3_se8_i2c {
	qcom,i2c-touch-active = "goodix,gt9896";

	/delete-node/ focaltech@38;
	goodix-gtx8@5d {
		compatible = "goodix,gt9896";
		reg = <0x5d>;
		interrupt-parent = <&tlmm>;
		interrupts = <0x16 0x2800>;
		goodix,reset-gpio = <&tlmm 0x15 0x00>;
		goodix,irq-gpio = <&tlmm 0x16 0x2800>;
		goodix,avdd-gpio = <&tlmm 0x33 0x00>;
		goodix,dvdd-gpio = <&tlmm 0x2c 0x00>;
		pinctrl-names = "pmx_ts_active", "pmx_ts_suspend", "pmx_ts_release";
		pinctrl-0 = <&ts_active>;
		pinctrl-1 = <&ts_int_suspend &ts_reset_suspend>;
		pinctrl-2 = <&pmx_ts_release>;
		goodix,irq-flags = <IRQ_TYPE_EDGE_FALLING>;
		goodix,panel-max-x = <8640>;
		goodix,panel-max-y = <19200>;
		goodix,panel-max-w = <255>;
		goodix,pen-enable;
		panel = <&dsi_k6s_38_0c_0a_fhd_dsc_video>;
	};
};
