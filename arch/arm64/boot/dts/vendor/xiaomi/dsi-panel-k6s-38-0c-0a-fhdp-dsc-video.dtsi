&mdss_mdp {
	dsi_k6s_38_0c_0a_fhd_dsc_video:	qcom,mdss_dsi_k6s_38_0c_0a_fhdp_dsc_vid {
		qcom,mdss-dsi-panel-name = "xiaomi k6s 38 0c 0a fhd dsc video dsi panel";
		qcom,dsi-ctrl-num = <0>;
		qcom,dsi-phy-num = <0>;
		qcom,mdss-dsi-bl-inverted-dbv;
		qcom,mdss-dsi-panel-type = "dsi_video_mode";
		qcom,mdss-dsi-virtual-channel-id = <0>;
		qcom,mdss-dsi-stream = <0>;
		qcom,mdss-dsi-bpp = <24>;
		qcom,mdss-dsi-color-order = "rgb_swap_rgb";
		qcom,mdss-dsi-underflow-color = <0xff>;
		qcom,mdss-dsi-border-color = <0>;
		qcom,mdss-dsi-traffic-mode = "burst_mode";
		qcom,mdss-dsi-bllp-eof-power-mode;
		qcom,mdss-dsi-bllp-power-mode;
		qcom,mdss-dsi-lp11-init;
		qcom,mdss-dsi-lane-0-state;
		qcom,mdss-dsi-lane-1-state;
		qcom,mdss-dsi-lane-2-state;
		qcom,mdss-dsi-lane-3-state;
		qcom,bl-update-flag = "delay_until_first_frame";
		qcom,mdss-dsi-dma-trigger = "trigger_sw";
		qcom,mdss-dsi-mdp-trigger = "none";
		qcom,mdss-dsi-bl-dcs-type-ss-ea;
		qcom,mdss-dsi-reset-sequence = <0 1>, <1 10>;
		qcom,mdss-pan-physical-width-dimension = <695>;
		qcom,mdss-pan-physical-height-dimension = <1546>;
		qcom,mdss-dsi-tx-eot-append;
		qcom,esd-err-irq-gpio = <&tlmm 85 0x2002>;
		qcom,mdss-dsi-pan-enable-dynamic-fps;
		qcom,mdss-dsi-pan-fps-update = "dfps_immediate_porch_mode_vfp";
		qcom,dsi-supported-dfps-list = <120 60>;
		mi,mdss-dsi-doze-hbm-brightness-value = <272>;
		mi,mdss-dsi-doze-lbm-brightness-value = <22>;
		qcom,mdss-dsi-oled-panel-video-mode;
		qcom,dsi-dyn-clk-enable;
		qcom,dsi-dyn-clk-type = "constant-fps-adjust-vfp";
		qcom,dsi-dyn-clk-list = <1099653120 1079034624>;
		qcom,dsi-select-clocks = "mux_byte_clk0", "mux_pixel_clk0", "src_byte_clk0", "src_pixel_clk0", "shadow_byte_clk0", "shadow_pixel_clk0";
		qcom,panel-supply-entries = <&dsi_panel_pwr_supply_avdd>;
		qcom,mdss-dsi-bl-pmic-control-type = "bl_ctrl_dcs";
		qcom,mdss-dsi-bl-min-level = <4>;
		qcom,mdss-dsi-bl-max-level = <2047>;
		qcom,mdss-brightness-max-level = <2047>;
		qcom,platform-en-gpio = <&tlmm 47 0>;
		qcom,platform-te-gpio = <&tlmm 23 0>;
		qcom,platform-reset-gpio = <&pmr735a_gpios 2 0>;

		qcom,mdss-dsi-display-timings {
			timing@0 {
				qcom,mdss-dsi-panel-width = <1080>;
				qcom,mdss-dsi-panel-height = <2400>;
				qcom,mdss-dsi-h-front-porch = <120>;
				qcom,mdss-dsi-h-back-porch = <120>;
				qcom,mdss-dsi-h-pulse-width = <28>;
				qcom,mdss-dsi-h-sync-skew = <0>;
				qcom,mdss-dsi-v-back-porch = <10>;
				qcom,mdss-dsi-v-front-porch = <20>;
				qcom,mdss-dsi-v-pulse-width = <2>;
				qcom,mdss-dsi-h-left-border = <0>;
				qcom,mdss-dsi-h-right-border = <0>;
				qcom,mdss-dsi-v-top-border = <0>;
				qcom,mdss-dsi-v-bottom-border = <0>;
				qcom,mdss-dsi-panel-framerate = <120>;
				qcom,mdss-dsi-on-command = [05 01 00 00 14 00 02 11 00 39 01 00 00 00 00 03 f0 5a 5a 39 01 00 00 00 00 03 b2 01 31 39 01 00 00 00 00 06 df 09 30 95 46 e9 39 01 00 00 00 00 03 f0 a5 a5 39 01 00 00 00 00 02 9d 01 39 01 00 00 00 00 5a 9e 11 00 00 89 30 80 09 60 04 38 00 28 02 1c 02 1c 02 00 02 0e 00 20 03 dd 00 07 00 0c 02 77 02 8b 18 00 10 f0 03 0c 20 00 06 0b 0b 33 0e 1c 2a 38 46 54 62 69 70 77 79 7b 7d 7e 01 02 01 00 09 40 09 be 19 fc 19 fa 19 f8 1a 38 1a 78 1a b6 2a f6 2b 34 2b 74 3b 74 6b f4 00 39 01 00 00 00 00 03 f0 5a 5a 39 01 00 00 00 00 02 60 21 39 01 00 00 00 00 02 f7 0b 39 01 00 00 00 00 03 f0 a5 a5 39 01 00 00 00 00 03 f0 5a 5a 39 01 00 00 00 00 04 b0 00 15 f6 39 01 00 00 00 00 02 f6 f0 39 01 00 00 00 00 04 b0 00 28 f6 39 01 00 00 00 00 02 f6 f0 39 01 00 00 00 00 04 b0 00 3b f6 39 01 00 00 00 00 02 f6 f0 39 01 00 00 00 00 04 b0 00 0a f4 39 01 00 00 00 00 02 f4 98 39 01 00 00 00 00 04 b0 00 11 f4 39 01 00 00 00 00 02 f4 ee 39 01 00 00 00 00 04 b0 00 18 b2 39 01 00 00 00 00 02 b2 1c 39 01 00 00 00 00 03 fc 5a 5a 39 00 00 00 00 00 04 b0 00 11 fe 39 00 00 00 00 00 02 fe 00 39 01 00 00 00 00 03 fc a5 a5 39 01 00 00 00 00 04 b0 00 0d b2 39 01 00 00 00 00 02 b2 20 39 01 00 00 00 00 04 b0 00 0c b2 39 01 00 00 00 00 02 b2 30 39 01 00 00 00 00 02 f7 0b 39 01 00 00 00 00 03 f0 a5 a5 39 01 00 00 00 00 03 f0 5a 5a 39 01 00 00 00 00 03 fc 5a 5a 39 01 00 00 00 00 04 ed 01 cd 00 39 01 00 00 00 00 02 e1 93 39 01 00 00 00 00 04 b0 00 06 f4 39 01 00 00 00 00 02 f4 1f 39 01 00 00 00 00 03 f0 a5 a5 39 01 00 00 00 00 03 fc a5 a5 39 01 00 00 00 00 02 53 20 39 01 00 00 64 00 03 51 00 00 05 01 00 00 00 00 02 29 00];
				qcom,mdss-dsi-pre-off-command = [05 01 00 00 14 00 02 28 00 05 01 00 00 96 00 02 10 00];
				qcom,mdss-dsi-on-command-state = "dsi_lp_mode";
				qcom,mdss-dsi-pre-off-command-state = "dsi_hs_mode";
				qcom,mdss-dsi-dispparam-dimmingon-command = [39 01 00 00 01 00 02 53 28];
				qcom,mdss-dsi-dispparam-dimmingon-command-state = "dsi_lp_mode";
				qcom,mdss-dsi-dispparam-dimmingoff-command = [39 01 00 00 01 00 02 53 20];
				qcom,mdss-dsi-dispparam-dimmingoff-command-state = "dsi_lp_mode";
				qcom,mdss-dsi-dispparam-hbm-on-l1-command = <0x39010000 0x253 0xe8390100 0x03 0x51025839 0x1000000 0x2f70b>;
				qcom,mdss-dsi-dispparam-hbm-on-l1-command-state = "dsi_lp_mode";
				qcom,mdss-dsi-dispparam-hbm-on-l2-command = <0x39010000 0x253 0xe8390100 0x03 0x5104b039 0x1000000 0x2f70b>;
				qcom,mdss-dsi-dispparam-hbm-on-l2-command-state = "dsi_lp_mode";
				qcom,mdss-dsi-dispparam-hbm-on-l3-command = <0x39010000 0x253 0xe8390100 0x03 0x5107ff39 0x1000000 0x2f70b>;
				qcom,mdss-dsi-dispparam-hbm-on-l3-command-state = "dsi_lp_mode";
				qcom,mdss-dsi-dispparam-hbm-off-command = [39 00 00 00 00 00 02 53 28 39 01 00 00 00 00 03 51 07 ff];
				qcom,mdss-dsi-dispparam-hbm-off-command-state = "dsi_lp_mode";
				qcom,mdss-dsi-doze-hbm-command = [39 01 00 00 00 00 03 51 01 10];
				qcom,mdss-dsi-doze-hbm-command-state = "dsi_lp_mode";
				qcom,mdss-dsi-doze-lbm-command = [39 01 00 00 00 00 03 51 00 16];
				qcom,mdss-dsi-doze-lbm-command-state = "dsi_lp_mode";
				qcom,mdss-dsi-dispparam-flat-mode-on-command = [39 01 00 00 00 00 03 f0 5a 5a 39 01 00 00 00 00 04 b0 00 88 b1 39 01 00 00 00 00 29 b1 27 2d fb 0f a4 86 01 ff 10 33 ff 10 ff 35 34 5a 0a 0a 0a 29 29 29 37 37 37 41 41 41 45 45 45 1b 2f da 18 74 80 00 00 22 39 01 00 00 00 00 03 f0 a5 a5];
				qcom,mdss-dsi-dispparam-flat-mode-on-command-state = "dsi_lp_mode";
				qcom,mdss-dsi-dispparam-flat-mode-off-command = [39 01 00 00 00 00 03 f0 5a 5a 39 01 00 00 00 00 04 b0 00 88 b1 39 01 00 00 00 00 29 b1 27 0d fb 0f a4 86 01 ff 10 33 ff 10 ff 35 34 5a 0a 0a 0a 29 29 29 37 37 37 41 41 41 45 45 45 1b 2f da 18 74 80 00 00 22 39 01 00 00 00 00 03 f0 a5 a5];
				qcom,mdss-dsi-dispparam-flat-mode-off-command-state = "dsi_lp_mode";
				qcom,mdss-dsi-dispparam-bc-120hz-command = [39 00 00 00 00 00 03 f0 5a 5a 39 00 00 00 00 00 02 60 01 39 00 00 00 00 00 02 f7 0b 39 01 00 00 00 00 03 f0 a5 a5];
				qcom,mdss-dsi-dispparam-bc-120hz-command-state = "dsi_lp_mode";
				qcom,mdss-dsi-dispparam-bc-60hz-command = <0x39000000 0x3f0 0x5a5a3900 0x00 0x2602139 0x1000000 0x2f70b>;
				qcom,mdss-dsi-dispparam-bc-60hz-command-state = "dsi_hs_mode";
				qcom,compression-mode = "dsc";
				qcom,mdss-dsc-version = <0x11>;
				qcom,mdss-dsc-scr-version = <0>;
				qcom,mdss-dsc-slice-height = <20>;
				qcom,mdss-dsc-slice-width = <540>;
				qcom,mdss-dsc-slice-per-pkt = <2>;
				qcom,mdss-dsc-bit-per-component = <8>;
				qcom,mdss-dsc-bit-per-pixel = <8>;
				qcom,mdss-dsc-block-prediction-enable;
				qcom,mdss-dsi-dispparam-60hz-dc-crc-setting-command = <0x39000000 0x3f0 0x5a5a3900 0x00 0x2800539 0x00 0x2b100 0x39000000 0x4b0 0x1b139 0x00 0x16b101 0x01 0x01 0x10101 0x10101 0x10101 0x39000000 0x3f0 0xa5a53901 0x00 0x35101e8>;
				qcom,mdss-dsi-dispparam-60hz-dc-crc-setting-command-state = "dsi_lp_mode";
				qcom,mdss-dsi-dispparam-120hz-dc-crc-setting-command = <0x39010000 0x3f0 0x5a5a3900 0x00 0x2800539 0x00 0x2b100 0x39000000 0x4b0 0x1b139 0x00 0x16b101 0x01 0x01 0x10101 0x10101 0x10101 0x39000000 0x3f0 0xa5a53901 0x00 0x35101e8>;
				qcom,mdss-dsi-dispparam-120hz-dc-crc-setting-command-state = "dsi_hs_mode";
				qcom,mdss-dsi-dispparam-seed-control-command = [39 01 00 00 00 00 03 f0 5a 5a 39 01 00 00 00 00 02 80 05 39 01 00 00 00 00 02 b1 00 39 01 00 00 00 00 04 b0 00 01 b1 39 01 00 00 00 00 16 b1 c9 00 00 16 cc 02 07 0b b5 21 ef de e5 0d d3 ee df 02 ff ff ff 39 01 00 00 00 00 03 f0 a5 a5];
				qcom,mdss-dsi-dispparam-seed-control-command-state = "dsi_hs_mode";
				qcom,mdss-dsi-dispparam-crc-off-command = [39 00 00 00 00 00 03 f0 5a 5a 39 00 00 00 00 00 02 80 00 39 00 00 00 00 00 02 b1 01 39 01 00 00 00 00 03 f0 a5 a5];
				qcom,mdss-dsi-dispparam-crc-off-command-state = "dsi_lp_mode";
				qcom,mdss-dsi-panel-phy-timings = [00 23 09 09 1a 18 09 09 09 02 04 00 1d 0e];
				qcom,display-topology = <1 1 1>;
				qcom,default-topology-index = <0>;
			};
		};
	};
};
