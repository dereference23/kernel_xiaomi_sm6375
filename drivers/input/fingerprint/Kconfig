## drivers/input/fingerprint/Kconfig
```kconfig
# SPDX-License-Identifier: GPL-2.0-only
#
# Fingerprint driver configuration
#
menuconfig INPUT_FINGERPRINT
        bool "Fingerprint sensors"
        help
          Say Y here, and a list of supported fingerprint sensors will be displayed.
          This option doesn't affect the kernel.

          If unsure, say Y.

if INPUT_FINGERPRINT

source "drivers/input/fingerprint/fpc/Kconfig"

source "drivers/input/fingerprint/goodix/Kconfig"

endif
```

## drivers/input/fingerprint/fpc/Kconfig
```kconfig
config FINGERPRINT_FPC
       tristate "FPC_BTP fingerprint sensor support"
       help
          tristate "FPC_BTP fingerprint sensor support"
```

## drivers/input/fingerprint/silead/Kconfig
```kconfig
#
# Silead Fingerprint driver configuration
#

config FINGERPRINT_SILEAD
        tristate "Silead Fingerprint driver support"
        help
	  This supports Silead Fingerprint drivers.
```
