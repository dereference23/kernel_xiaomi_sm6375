#include "../qcom/blair-qrd-nopmi.dts"
#include "veux-audio.dtsi"
#include "veux-camera.dtsi"
#include "veux-consumerir.dtsi"
#include "veux-display.dtsi"
#include "veux-fingerprint.dtsi"
#include "veux-haptics.dtsi"
#include "veux-memory.dtsi"
#include "veux-nfc.dtsi"
#include "veux-pinctrl.dtsi"
#include "veux-pmic.dtsi"
#include "veux-thermal.dtsi"
#include "veux-touchscreen.dtsi"
#include "veux-usb.dtsi"

/ {
	aliases {
		i2c3 = &qupv3_se10_i2c;
	};
};

&pm6125_l13 {
	/delete-property/ qcom,proxy-consumer-enable;
};

&qcom {
	/delete-property/ mem-type;
	console-size = <0x100000>;
	pmsg-size = <0x100000>;
};
